## main/Kconfig.projbuild
```kconfig
menu "Wi-Fi Configuration"
    config WIFI_SSID
        string "Wi-Fi SSID"
        default "ssid"
        help
            Enter the SSID of your Wi-Fi network.
    
    config WIFI_PASSWORD
        string "Wi-Fi Password"
        default "pass"
        help
            Enter the password of your Wi-Fi network.
    
    config WIFI_CONNECT_ATTEMPTS
        int "Wi-Fi Connect Attempts"
        default 10
        help
            Enter the max amount of connect attemts to connect to Wi-Fi.
endmenu

menu "Build Configuration"
    choice
        prompt "Select which device you want to flash:"
        default BENCH_BUILD_ENABLED

    config BENCH_BUILD_ENABLED
        bool "Bench"

    config RADIO_BUILD_ENABLED
        bool "Radio"

    endchoice
endmenu
```
